#include <SPI.h>
#include <Wire.h>
#include <Adafruit_GFX.h>
#include <Adafruit_SSD1306.h>
#define SCREEN_WIDTH 128 // OLED display width, em pixels
#define SCREEN_HEIGHT 64
//Declaração para conexão I2C
#define OLED_RESET  -1 //Reseta o pin
Adafruit_SSD1306 display(SCREEN_WIDTH, SCREEN_HEIGHT, &Wire, OLED_RESET);

//No centro
const unsigned char nocentro [] PROGMEM = {
  0x00, 0x00, 0x00, 0x00, 0x00, 0x00, 0x00, 0x00, 0x00, 0x00, 0x00, 0x00, 0x00, 0x00, 0x00, 0x00, 
  0x00, 0x00, 0x00, 0x00, 0x00, 0x00, 0x00, 0x00, 0x00, 0x00, 0x00, 0x00, 0x00, 0x00, 0x00, 0x00, 
  0x00, 0x00, 0x00, 0x00, 0x00, 0x00, 0x00, 0x00, 0x00, 0x00, 0x00, 0x00, 0x00, 0x00, 0x00, 0x00, 
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  0x00, 0x00, 0x00, 0x00, 0x00, 0x00, 0x00, 0x00, 0x00, 0x00, 0x00, 0x00, 0x00, 0x00, 0x00, 0x00
};

//Diagonal esquerda
const unsigned char diagesquerda [] PROGMEM = {
  0x00, 0x00, 0x00, 0x00, 0x00, 0x00, 0x00, 0x00, 0x00, 0x00, 0x00, 0x00, 0x00, 0x00, 0x00, 0x00, 
  0x00, 0x00, 0x00, 0x00, 0x00, 0x00, 0x00, 0x00, 0x00, 0x00, 0x00, 0x00, 0x00, 0x00, 0x00, 0x00, 
  0x00, 0x00, 0x00, 0x00, 0x00, 0x00, 0x00, 0x00, 0x00, 0x00, 0x00, 0x00, 0x00, 0x00, 0x00, 0x00, 
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  0x00, 0x00, 0x00, 0x00, 0x00, 0x00, 0x00, 0x00, 0x00, 0x00, 0x00, 0x00, 0x00, 0x00, 0x00, 0x00
};

//Diagonal direita
const unsigned char diagdireita [] PROGMEM = {
  0x00, 0x00, 0x00, 0x00, 0x00, 0x00, 0x00, 0x00, 0x00, 0x00, 0x00, 0x00, 0x00, 0x00, 0x00, 0x00, 
  0x00, 0x00, 0x00, 0x00, 0x00, 0x00, 0x00, 0x00, 0x00, 0x00, 0x00, 0x00, 0x00, 0x00, 0x00, 0x00, 
  0x00, 0x00, 0x00, 0x00, 0x00, 0x00, 0x00, 0x00, 0x00, 0x00, 0x00, 0x00, 0x00, 0x00, 0x00, 0x00, 
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  0x00, 0x00, 0x00, 0x00, 0x00, 0x00, 0x00, 0x00, 0x00, 0x00, 0x00, 0x00, 0x00, 0x00, 0x00, 0x00
};

//Lado direito
const unsigned char ladodireito [] PROGMEM = {
  0x00, 0x00, 0x00, 0x00, 0x00, 0x00, 0x00, 0x00, 0x00, 0x00, 0x00, 0x00, 0x00, 0x00, 0x00, 0x00, 
  0x00, 0x00, 0x00, 0x00, 0x00, 0x00, 0x00, 0x00, 0x00, 0x00, 0x00, 0x00, 0x00, 0x00, 0x00, 0x00, 
  0x00, 0x00, 0x00, 0x00, 0x00, 0x00, 0x00, 0x00, 0x00, 0x00, 0x00, 0x00, 0x00, 0x00, 0x00, 0x00, 
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  0x00, 0x00, 0x00, 0x00, 0x00, 0x00, 0x00, 0x00, 0x00, 0x00, 0x00, 0x00, 0x00, 0x00, 0x00, 0x00
};

//Lado esquerdo
const unsigned char ladoesquerdo [] PROGMEM = {
  0x00, 0x00, 0x00, 0x00, 0x00, 0x00, 0x00, 0x00, 0x00, 0x00, 0x00, 0x00, 0x00, 0x00, 0x00, 0x00, 
  0x00, 0x00, 0x00, 0x00, 0x00, 0x00, 0x00, 0x00, 0x00, 0x00, 0x00, 0x00, 0x00, 0x00, 0x00, 0x00, 
  0x00, 0x00, 0x00, 0x00, 0x00, 0x00, 0x00, 0x00, 0x00, 0x00, 0x00, 0x00, 0x00, 0x00, 0x00, 0x00, 
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  0x00, 0x00, 0x00, 0x00, 0x00, 0x00, 0x00, 0x00, 0x00, 0x00, 0x00, 0x00, 0x00, 0x00, 0x00, 0x00
};

//Risco de Queda
const unsigned char riscoqueda [] PROGMEM = {
  0x00, 0x00, 0x00, 0x00, 0x00, 0x00, 0x00, 0x00, 0x00, 0x00, 0x00, 0x00, 0x00, 0x00, 0x00, 0x00, 
  0x00, 0x00, 0x00, 0x00, 0x00, 0x00, 0x00, 0x00, 0x00, 0x00, 0x00, 0x00, 0x00, 0x00, 0x00, 0x00, 
  0x00, 0x00, 0x00, 0x00, 0x00, 0x00, 0x00, 0x00, 0x00, 0x00, 0x00, 0x00, 0x00, 0x00, 0x00, 0x00, 
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  0x00, 0x00, 0x00, 0x00, 0x00, 0x00, 0x00, 0x00, 0x00, 0x00, 0x00, 0x00, 0x00, 0x00, 0x00, 0x00
};

//Fora do berço
const unsigned char foraberco [] PROGMEM = {
  0x00, 0x00, 0x00, 0x00, 0x00, 0x00, 0x00, 0x00, 0x00, 0x00, 0x00, 0x00, 0x00, 0x00, 0x00, 0x00, 
  0x00, 0x00, 0x00, 0x00, 0x00, 0x00, 0x00, 0x00, 0x00, 0x00, 0x00, 0x00, 0x00, 0x00, 0x00, 0x00, 
  0x00, 0x00, 0x00, 0x00, 0x00, 0x00, 0x00, 0x00, 0x00, 0x00, 0x00, 0x00, 0x00, 0x00, 0x00, 0x00, 
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  0x00, 0x00, 0x00, 0x00, 0x00, 0x00, 0x00, 0x00, 0x00, 0x00, 0x00, 0x00, 0x00, 0x00, 0x00, 0x00
};

//Risco de asfixia
const unsigned char asfixia [] PROGMEM = {
  0x00, 0x00, 0x00, 0x00, 0x00, 0x00, 0x00, 0x00, 0x00, 0x00, 0x00, 0x00, 0x00, 0x00, 0x00, 0x00, 
  0x00, 0x00, 0x00, 0x00, 0x00, 0x00, 0x00, 0x00, 0x00, 0x00, 0x00, 0x00, 0x00, 0x00, 0x00, 0x00, 
  0x00, 0x00, 0x1f, 0xff, 0xff, 0xfe, 0x00, 0x00, 0x00, 0x00, 0x00, 0x00, 0x00, 0x00, 0x00, 0x00, 
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  0x00, 0x00, 0x00, 0x00, 0x00, 0x00, 0x00, 0x00, 0x00, 0x00, 0x00, 0x00, 0x00, 0x00, 0x00, 0x00
};

//Erro no sistema
const unsigned char errosistema [] PROGMEM = {
  0x00, 0x00, 0x00, 0x00, 0x00, 0x00, 0x00, 0x00, 0x00, 0x00, 0x00, 0x00, 0x00, 0x00, 0x00, 0x00, 
  0x00, 0x00, 0x00, 0x00, 0x00, 0x00, 0x00, 0x00, 0x00, 0x00, 0x00, 0x00, 0x00, 0x00, 0x00, 0x00, 
  0x00, 0x00, 0x00, 0x00, 0x00, 0x00, 0x00, 0x00, 0x00, 0x00, 0x00, 0x00, 0x00, 0x00, 0x00, 0x00, 
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  0x00, 0x00, 0x00, 0x00, 0x00, 0x00, 0x00, 0x00, 0x00, 0x00, 0x00, 0x00, 0x00, 0x00, 0x00, 0x00
};

const int pinoPrimeiraChave = 10;
const int pinoSegundaChave = 9;
const int pinoTerceiraChave = 6;
const int pinoQuartaChave = 7;
const int pinoQuintaChave = 8;
const int pinoLed = 12;
const int buzzer = 13;
const int pinoButton = 11;
const int pinoMagDigital = 5;
const int pinoMagAnalog = A0;
const int pinoOledSCL = A4;
const int pinoOledSDA = A5;


void setup() {
pinMode(pinoPrimeiraChave, INPUT_PULLUP); //DEFINE O PINO COMO ENTRADA / "_PULLUP" É PARA ATIVAR O RESISTOR INTERNO
pinMode(pinoSegundaChave, INPUT_PULLUP);
pinMode(pinoTerceiraChave, INPUT_PULLUP);
pinMode(pinoQuartaChave, INPUT_PULLUP);
pinMode(pinoQuintaChave, INPUT_PULLUP);
pinMode(pinoMagDigital, INPUT);
pinMode(pinoLed, OUTPUT); //Define como saída
pinMode(buzzer, OUTPUT); //Define como saída
pinMode(pinoButton, INPUT);
digitalWrite(pinoButton, LOW);
digitalWrite(buzzer, LOW); //Buzzer inicia desligado
digitalWrite(pinoLed, LOW); //Led inicia desligado
display.begin(SSD1306_SWITCHCAPVCC, 0x3C);
display.clearDisplay();
Serial.begin(9600); // Inicializa a comunicação serial com taxa de transmissão de 9600 bps
}

void loop(){
  int valor_d=digitalRead(pinoMagDigital);
  int valor_a=analogRead(pinoMagAnalog);
  int chave1=digitalRead(pinoPrimeiraChave);
  int chave2=digitalRead(pinoSegundaChave);
  int chave3=digitalRead(pinoTerceiraChave);
  int chave4=digitalRead(pinoQuartaChave);
  int chave5=digitalRead(pinoQuintaChave);
  int estadoBotao = digitalRead(pinoButton);
  time = millis();
  
if(chave1==LOW and chave4==LOW){
      //Sem necessidade de alarme/
      digitalWrite(pinoLed, LOW);
      digitalWrite(buzzer, LOW);
      Serial.println("Lado esquerdo"); //Envia uma mensagem de texto pela porta serial
	  Serial.println(millis());
      display.drawBitmap(0, 0, ladoesquerdo, 128, 64, WHITE); //Atualiza oled
      display.display();
      while(millis() < time+1000); //Aguarda por 1 segundo
      display.clearDisplay(); //Limpa o buffer
  }else if (chave2==LOW && chave5==LOW){ 
      //Sem necessidade de alarme/
      digitalWrite(pinoLed, LOW);
      digitalWrite(buzzer, LOW);
      Serial.println("Lado direito");
	  Serial.println(millis());
      display.drawBitmap(0, 0, ladodireito, 128, 64, WHITE); //Atualiza oled
      display.display();
      while(millis() < time+1000); //Aguarda por 1 segundo
      display.clearDisplay(); //Limpa o buffer
  }else if (chave1==LOW && chave3==LOW && chave5==LOW){ 
      //Sem necessidade de alarme/
      digitalWrite(pinoLed, LOW);
      digitalWrite(buzzer, LOW);
      Serial.println("Diagonal esquerda");
	  Serial.println(millis());
      display.drawBitmap(0, 0, diagesquerda, 128, 64, WHITE); //Atualiza oled
      display.display();
      while(millis() < time+1000);//Aguarda por 1 segundo
      display.clearDisplay(); //Limpa o buffer
  }else if (chave2==LOW && chave3==LOW && chave4==LOW){ 
      //Sem necessidade de alarme/
      digitalWrite(pinoLed, LOW);
      digitalWrite(buzzer, LOW);
      Serial.println("Diagonal direita");
	  Serial.println(millis());
      display.drawBitmap(0, 0, diagdireita, 128, 64, WHITE); //Atualiza oled
      display.display();
      while(millis() < time+1000); //Aguarda por 1 segundo
      display.clearDisplay(); //Limpa o buffer
  }else if (chave1==HIGH && chave2==HIGH && chave3==HIGH && chave4==HIGH && chave5==HIGH){ 
      digitalWrite(pinoLed, HIGH);
      digitalWrite(buzzer, HIGH);
      Serial.println("Bebê fora do berço!");
	  Serial.println(millis());
      display.drawBitmap(0, 0, foraberco, 128, 64, WHITE); //Atualiza oled
      display.display();
      while(millis() < time+1000); //Aguarda por 1 segundo
      display.clearDisplay(); //Limpa o buffer
  }else if (valor_d==1){
      digitalWrite(pinoLed, HIGH);
      digitalWrite(buzzer, HIGH);
      Serial.println("Alerta: Risco de asfixia!");
	  Serial.println(millis());
      display.drawBitmap(0, 0, asfixia, 128, 64, WHITE); //Atualiza oled
      display.display();
      while(millis() < time+1000); //Aguarda por 1 segundo
      display.clearDisplay(); //Limpa o buffer
  }else if (chave1==LOW){ 
      digitalWrite(pinoLed, HIGH);
      digitalWrite(buzzer, LOW);
      Serial.println("Atenção: risco de queda!");
	  Serial.println(millis());
      display.drawBitmap(0, 0, riscoqueda, 128, 64, WHITE); //Atualiza oled
      display.display();
      while(millis() < time+1000); //Aguarda por 1 segundo
      display.clearDisplay(); //Limpa o buffer
  }else if (chave5==LOW){ 
      digitalWrite(pinoLed, HIGH);
      digitalWrite(buzzer, LOW);
      Serial.println("Atenção: risco de queda!");
	  Serial.println(millis());
      display.drawBitmap(0, 0, riscoqueda, 128, 64, WHITE); //Atualiza oled
      display.display();
      while(millis() < time+1000); //Aguarda por 1 segundo
      display.clearDisplay(); //Limpa o buffer
  }else if (chave2==LOW){ 
      digitalWrite(pinoLed, HIGH);
      digitalWrite(buzzer, LOW);
      Serial.println("Atenção: risco de queda!");
	  Serial.println(millis());
      display.drawBitmap(0, 0, riscoqueda, 128, 64, WHITE); //Atualiza oled
      display.display();
      while(millis() < time+1000); //Aguarda por 1 segundo
      display.clearDisplay(); //Limpa o buffer
  }else if (chave4==LOW){
      digitalWrite(pinoLed, HIGH);
      digitalWrite(buzzer, LOW);
      Serial.println("Atenção: risco de queda!");
	  Serial.println(millis());
      display.drawBitmap(0, 0, riscoqueda, 128, 64, WHITE); //Atualiza oled
      display.display();
      while(millis() < time+1000); //Aguarda por 1 segundo
      display.clearDisplay(); //Limpa o buffer
  }else if (chave3==LOW){
      //Sem necessidade de alarme/
      digitalWrite(buzzer, LOW);
      Serial.println("No centro");
	  Serial.println(millis());
      display.drawBitmap(0, 0, nocentro, 128, 64, WHITE); //Atualiza oled
      display.display();
      while(millis() < time+1000); //Aguarda por 1 segundo
      display.clearDisplay(); //Limpa o buffer
  }
  else{
    //Sem necessidade de alarme/
    digitalWrite(buzzer, LOW);
    Serial.println("Erro no sistema!");
	Serial.println(millis());
    display.drawBitmap(0, 0, errosistema, 128, 64, WHITE); //Atualiza oled
    display.display();
    while(millis() < time+1000); //Aguarda por 1 segundo
    display.clearDisplay(); //Limpa o buffer
  }
}
